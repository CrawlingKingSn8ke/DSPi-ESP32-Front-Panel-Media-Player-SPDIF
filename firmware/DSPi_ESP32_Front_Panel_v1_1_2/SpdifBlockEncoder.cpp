#include "SpdifBlockEncoder.h"

#include <pgmspace.h>

namespace {

// Tested 24-bit ESP32 S/PDIF coding from squeezelite-esp32 output_i2s.c
// (Sebastien 2019, Philippe G. 2019; MIT License). Values are arranged for
// the ESP32 I2S peripheral's MSB-first 32-bit output slots.
static const uint16_t kBmcLookup[256] PROGMEM = {
  0xcccc, 0xb333, 0xd333, 0xaccc, 0xcb33, 0xb4cc, 0xd4cc, 0xab33,
  0xcd33, 0xb2cc, 0xd2cc, 0xad33, 0xcacc, 0xb533, 0xd533, 0xaacc,
  0xccb3, 0xb34c, 0xd34c, 0xacb3, 0xcb4c, 0xb4b3, 0xd4b3, 0xab4c,
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  0xcd55, 0xb2aa, 0xd2aa, 0xad55, 0xcaaa, 0xb555, 0xd555, 0xaaaa
};

constexpr uint8_t kPreambleB = 0xE8u;
constexpr uint8_t kPreambleM = 0xE2u;
constexpr uint8_t kPreambleW = 0xE4u;
constexpr uint8_t kVucpByPhase[2] = {0xCCu, 0x32u};

void encodeChannel24(int32_t sample, uint8_t preamble, uint8_t &vucp,
                     uint32_t *destination)
{
  uint16_t high = pgm_read_word(&kBmcLookup[
      static_cast<uint8_t>(static_cast<uint32_t>(sample) >> 24)]);
  uint16_t low = pgm_read_word(&kBmcLookup[
      static_cast<uint8_t>(static_cast<uint32_t>(sample) >> 16)]);
  const uint16_t auxiliary = pgm_read_word(&kBmcLookup[
      static_cast<uint8_t>(static_cast<uint32_t>(sample) >> 8)]);

  if (auxiliary & 1u) low = static_cast<uint16_t>(~low);
  if (low & 1u) high = static_cast<uint16_t>(~high);

  destination[0] = (static_cast<uint32_t>(vucp) << 24) |
                   (static_cast<uint32_t>(preamble) << 16) |
                   auxiliary;
  destination[1] = (static_cast<uint32_t>(low) << 16) | high;
  vucp = kVucpByPhase[high & 1u];
}

}  // namespace

void SpdifBlockEncoder::reset()
{
  frameNumber_ = 0;
  vucp_ = kVucpByPhase[0];
}

bool SpdifBlockEncoder::encode(const int32_t *stereoPcm, size_t frames,
                               uint32_t *encodedWords,
                               size_t encodedWordCapacity)
{
  if (!encodedWords || encodedWordCapacity < frames * kWordsPerStereoFrame) {
    return false;
  }

  for (size_t frame = 0; frame < frames; frame++) {
    const int32_t left = stereoPcm ? stereoPcm[frame * 2] : 0;
    const int32_t right = stereoPcm ? stereoPcm[frame * 2 + 1] : 0;
    uint32_t *destination = encodedWords + frame * kWordsPerStereoFrame;

    encodeChannel24(left, frameNumber_ == 0 ? kPreambleB : kPreambleM,
                    vucp_, destination);
    encodeChannel24(right, kPreambleW, vucp_, destination + 2);

    frameNumber_++;
    if (frameNumber_ >= 192) frameNumber_ = 0;
  }
  return true;
}
